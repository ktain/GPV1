#include "stm32f4xx.h"
#include <stdio.h>
#include <string.h>

#include "setup.h"
#include "display.h"

char displayStr[36];
int32_t displayDelay_ms;
int32_t displayDelayCounter;
int32_t displayBrightness;
int32_t displayIndex;

void writeControlRegister(char c)
{
	RS_HI;	// Switch to control register
	CE_LO;	// Enable data writing

	while (SPI_I2S_GetFlagStatus(SPI2, SPI_I2S_FLAG_TXE) == RESET);
	SPI_I2S_SendData(SPI2, c);
	while (SPI_I2S_GetFlagStatus(SPI2, SPI_I2S_FLAG_TXE) == RESET);
	while (SPI_I2S_GetFlagStatus(SPI2, SPI_I2S_FLAG_BSY) == SET);

	CE_HI;	// Latch on
	RS_LO;	// Switch back to data register
}


void display(char* str) {
	int32_t numChars = 0;
	
	// Change to new string. strcmp evaluates to true if not equal
	if (strcmp(displayStr,str)) {
		strcpy(displayStr, str);
		displayIndex = 0;
	}

	char const *ptr;	// to keep track of start of str
	RS_LO;			// Select control register
	CE_LO;			// Enable data writing

	// Static Display
	int32_t i;
	for (i = 0; displayStr[i] != '\0'; i++);	// count characters
	numChars = i;
	if (numChars <= 4) {
		for(int32_t j = 0; j < numChars; j++) {
			ptr = &fontTable[displayStr[j]*5];
			for(int32_t k = 0; k < 5; k++) {
				while (SPI_I2S_GetFlagStatus(SPI2, SPI_I2S_FLAG_TXE) == RESET);
				SPI_I2S_SendData(SPI2, *ptr);
				ptr++;
			}
		}
		for(int32_t j = numChars; j < 4; j++) {
			ptr = &fontTable[32*5];
			for(int32_t k = 0; k < 5; k++) {
				while (SPI_I2S_GetFlagStatus(SPI2, SPI_I2S_FLAG_TXE) == RESET);
				SPI_I2S_SendData(SPI2, *ptr);
				ptr++;
			}
		}
		while (SPI_I2S_GetFlagStatus(SPI2, SPI_I2S_FLAG_TXE) == RESET);
		while (SPI_I2S_GetFlagStatus(SPI2, SPI_I2S_FLAG_BSY) == SET);
		CE_HI;	//latch on
	}


	// Scroll display repeatedly
	else if (displayStr[displayIndex+3] == '\0') {
		displayIndex = 0;
		return;
	}

	// Display each of 20 columns
	for(int32_t j = 0; j < 4; j++) {
		ptr = &fontTable[displayStr[displayIndex+j]*5];
		for(int32_t k = 0; k < 5; k++) {
			while (SPI_I2S_GetFlagStatus(SPI2, SPI_I2S_FLAG_TXE) == RESET);
			SPI_I2S_SendData(SPI2, *ptr);
			ptr++;
		}
	}
	while (SPI_I2S_GetFlagStatus(SPI2, SPI_I2S_FLAG_TXE) == RESET);
	while (SPI_I2S_GetFlagStatus(SPI2, SPI_I2S_FLAG_BSY) == SET);
	CE_HI;	//latch on

	displayIndex++;

}

void displayFloat(float f) {
	char str[5];
	sprintf(str, "%.1f", f);
	display(str);
}

void displayInt(int32_t i) {
	char str[5];
	sprintf(str, "%4d", i);
	display(str);
}


void clearDisplay(void)
{
	strcpy(displayStr, "");
}

void setDisplayBrightness(int8_t brightness) {
	if (brightness < 0)
		brightness = 0;
	else if (brightness > 15)
		brightness = 15;

	writeControlRegister(0x60 | brightness);
}

/* Display voltage */
void displayVoltage(void){
	float voltageFloat;
	char voltageStr[5];
	voltageFloat = (float)read_Voltage/1000;
	snprintf(voltageStr, 5, "%f", voltageFloat);
	display(voltageStr);
}

/* Display error */
void displayError(void){
	display("err!");
}

/* Update display */
void updateDisplay(void){
	if (displayDelayCounter > 0)
		displayDelayCounter--;
	if (displayDelayCounter == 0) {
		display(displayStr);
		displayDelayCounter = displayDelay_ms;
	}
}


static const char fontTable[] = {
	//0
	0x80, 0x80, 0x80, 0x80, 0x80, // (space)
	0x40, 0x40, 0x40, 0x40, 0x40, // (space)
	0x20, 0x20, 0x20, 0x20, 0x20, // (space)
	0x10, 0x10, 0x10, 0x10, 0x10, // (space)
	0x08, 0x08, 0x08, 0x08, 0x08, // (space)
	0x04, 0x04, 0x04, 0x04, 0x04, // (space)
	0x02, 0x02, 0x02, 0x02, 0x02, // (space)
	0x01, 0x01, 0x01, 0x01, 0x01, // (space)
	//8
	0x80, 0x80, 0x80, 0x80, 0x80, // (space)
	0xc0, 0xc0, 0xc0, 0xc0, 0xc0, // (space)
	0xe0, 0xe0, 0xe0, 0xe0, 0xe0, // (space)
	0xf0, 0xf0, 0xf0, 0xf0, 0xf0, // (space)
	0xf8, 0xf8, 0xf8, 0xf8, 0xf8, // (space)
	0xfc, 0xfc, 0xfc, 0xfc, 0xfc, // (space)
	0xfe, 0xfe, 0xfe, 0xfe, 0xfe, // (space)
	0xff, 0xff, 0xff, 0xff, 0xff, // (space)
	//16
	0x7f, 0x7f, 0x7f, 0x7f, 0x7f, // (space)
	0x3f, 0x3f, 0x3f, 0x3f, 0x3f, // (space)
	0x1f, 0x1f, 0x1f, 0x1f, 0x1f, // (space)
	0x0f, 0x0f, 0x0f, 0x0f, 0x0f, // (space)
	0x07, 0x07, 0x07, 0x07, 0x07, // (space)
	0x03, 0x03, 0x03, 0x03, 0x03, // (space)
	0x01, 0x01, 0x01, 0x01, 0x01, // (space)
	0x00, 0x00, 0x00, 0x00, 0x00, // (space)

	//24
	0x7E, 0x42, 0x43, 0x42, 0x7E,
	0x7E, 0x62, 0x63, 0x62, 0x7E,
	0x7E, 0x72, 0x73, 0x72, 0x7E,
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	0x7C, 0x42, 0x72, 0x72, 0x7C,
	//32
	0x00, 0x00, 0x00, 0x00, 0x00, // space
	0x00, 0x00, 0x2f, 0x00, 0x00, // !
	0x00, 0x07, 0x00, 0x07, 0x00, // "
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	0x02, 0x01, 0x51, 0x09, 0x06, // ?
	//64
	0x32, 0x49, 0x59, 0x51, 0x3E, // @
	0x7E, 0x11, 0x11, 0x11, 0x7E, // A
	0x7F, 0x49, 0x49, 0x49, 0x36, // B
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	0x40, 0x40, 0x40, 0x40, 0x40, // _
	//96
	0x00, 0x01, 0x02, 0x04, 0x00, // '
	0x20, 0x54, 0x54, 0x54, 0x78, // a
	0x7F, 0x48, 0x44, 0x44, 0x38, // b
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	0x3C, 0x40, 0x30, 0x40, 0x3C, // w
	//120
	0x44, 0x28, 0x10, 0x28, 0x44, // x
	0x0C, 0x50, 0x50, 0x50, 0x3C, // y
	0x44, 0x64, 0x54, 0x4C, 0x44, // z
	0x00, 0x08, 0x36, 0x41, 0x00, // {
	0x00, 0x00, 0x7F, 0x00, 0x00, // |
	0x00, 0x41, 0x36, 0x08, 0x00, // }


};
